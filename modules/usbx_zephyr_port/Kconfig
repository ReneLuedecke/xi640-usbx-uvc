## modules/usbx_zephyr_port/Kconfig
```kconfig
# modules/usbx_zephyr_port/Kconfig

config USBX_ZEPHYR_PORT
    bool "USBX Zephyr OS Abstraction Layer"
    depends on USBX
    help
      Maps USBX OS primitives (threads, semaphores, mutexes, timers)
      to Zephyr kernel APIs.
      Requires: CONFIG_USB_DEVICE_STACK=n (USBX owns the controller)

config USBX_HEAP_SIZE
    int "USBX Static Heap Size (bytes)"
    depends on USBX_ZEPHYR_PORT
    default 65536
    help
      Static memory pool for USBX internal allocations.
      For UVC ISO 640x480: minimum 65536 recommended.
```

## west.yml
```yaml
manifest:
  version: "0.13"

  defaults:
    remote: zephyr

  remotes:
    - name: zephyr
      url-base: https://github.com/zephyrproject-rtos

  projects:
    - name: zephyr
      remote: zephyr
      revision: v4.1.0
      import: true

  self:
    path: app
    west-commands: scripts/west-commands.yml

# ---------------------------------------------------------------------------
# st_usbx: STM32CubeN6 USBX Middleware (Vendor Snapshot)
# Quelle:  https://github.com/STMicroelectronics/STM32CubeN6
# Commit:  TODO — nach erstem west update pinnen: git -C modules/st_usbx log --oneline -1
# ---------------------------------------------------------------------------
# Temporaer auskommentiert bis Commit SHA bekannt:
#  - name: st_usbx
#    url: https://github.com/STMicroelectronics/STM32CubeN6
#    revision: <COMMIT_SHA_HIER_EINSETZEN>
#    path: modules/st_usbx
#    import: false
```
